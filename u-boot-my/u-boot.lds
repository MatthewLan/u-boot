/*
 * .text
 *	程序代码段，即机器指令；
 *	将所有的目标文件里的.text段和在一起，并处理各个段之间的函数引用问题；
 *
 * .rodata
 *	常量区，存放常量数据；
 *	1. 有些立即数，是与指令编译在一起，直接放在代码段；
 *	2. 字符串常量，去掉重复的常量，只保存一份；
 *	3. 有些系统中，rodata段是多个进程共享的，目的是为了提高空间的利用率；
 *
 * .data
 *	初始化的全局变量；
 *	初始化为0的全局变量，出于编译优化的策略，还是被保存在BSS段；
 *
 * .bss
 *	未初始化的全局变量，或默认初始化为0的全局变量；
 *	不占用程序文件的大小，但占用程序执行时的内存空间；
 *	静态内存分配；
 *	程序中将BSS段清零；
 */

/*
 * 0x33f80000：
 *	到最高地址，刚好512KB的空间
 *	（不一定非这个值）
 */


SECTIONS {
	. = 0x33f80000;
	.text	: { *(.text) }
	
	. = ALIGN(4);
	.rodata	: { *(.rodata) }
	
	. = ALIGN(4);
	.data	: { *(.data) }
	
	. = ALIGN(4);
	__bss_start = .;
	.bss	: { *(.bss) *(COMMON) }
	__bss_end = .;
}
